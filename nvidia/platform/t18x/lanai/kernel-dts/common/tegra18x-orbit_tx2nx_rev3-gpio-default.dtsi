/*This dtsi file was generated by orbit_tx2nx.xlsm Revision:  */
/*
 * Copyright (c) 2017, NVIDIA CORPORATION.  All rights reserved.
 *
 * This program is free software; you can redistribute it and/or modify
 * it under the terms of the GNU General Public License as published by
 * the Free Software Foundation; either version 2 of the License, or
 * (at your option) any later version.
 *
 * This program is distributed in the hope that it will be useful, but WITHOUT
 * ANY WARRANTY; without even the implied warranty of MERCHANTABILITY or
 * FITNESS FOR A PARTICULAR PURPOSE.  See the GNU General Public License for
 * more details.
 */

#include <dt-bindings/gpio/tegra-gpio.h>

/ {
	gpio@2200000 {
		gpio-init-names = "default";
		gpio-init-0 = <&gpio_default>;

		gpio_default: default {
			gpio-input = <
				TEGRA_GPIO(C, 2)
				TEGRA_GPIO(C, 3)
				TEGRA_GPIO(FF, 1)
				TEGRA_GPIO(FF, 0)
				TEGRA_GPIO(X, 3)
				TEGRA_GPIO(Y, 3)
				TEGRA_GPIO(L, 1)
				TEGRA_GPIO(L, 4)
				TEGRA_GPIO(W, 4)
				TEGRA_GPIO(W, 5)
				TEGRA_GPIO(EE, 2)
				TEGRA_GPIO(AA, 7)
				>;
			gpio-output-low = <
				TEGRA_GPIO(C, 1)
				TEGRA_GPIO(C, 4)
				TEGRA_GPIO(J, 4)
				TEGRA_GPIO(N, 0)
				TEGRA_GPIO(N, 3)
				TEGRA_GPIO(U, 5)
				TEGRA_GPIO(L, 0)
				TEGRA_GPIO(L, 2)
				TEGRA_GPIO(L, 3)
				TEGRA_GPIO(H, 4)
				TEGRA_GPIO(H, 6)
				>;
			gpio-output-high = <
				>;
		};
	};
};
