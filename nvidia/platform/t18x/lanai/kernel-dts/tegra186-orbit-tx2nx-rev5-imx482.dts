/*
 * tegra186-orbit-tx2nx-rev5-imx482.dts : ScaleAQ Carrier board rev5
 *
 * Copyright (c) 2023, Scale Aquaculture <scaleaq.com>. All rights reserved.
 *
 * This program is free software; you can redistribute it and/or modify
 * it under the terms of the GNU General Public License as published by
 * the Free Software Foundation; version 2 of the License.
 *
 * This program is distributed in the hope that it will be useful, but WITHOUT
 * ANY WARRANTY; without even the implied warranty of MERCHANTABILITY or
 * FITNESS FOR A PARTICULAR PURPOSE.  See the GNU General Public License for
 * more details.
 */
#include "tegra186-orbit-tx2nx-rev4-imx482.dts"

/ {
	scaleaq,carrier_revision = "5";
};
